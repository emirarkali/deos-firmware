## CMakeLists.txt
```
cmake_minimum_required(VERSION 3.20.0)

find_package(Zephyr REQUIRED HINTS $ENV{ZEPHYR_BASE})
project(deos_traction)

target_include_directories(app PRIVATE include)

target_sources(app PRIVATE
    src/main.c
    src/traction_app.c
    src/traction_control.c
    src/traction_handlers.c
    src/traction_config.c
    src/traction_hw.c
    
    ../../lib/deos_core/src/deos_core.c
    ../../lib/deos_core/src/deos_rx.c
    ../../lib/deos_core/src/deos_tx.c
    ../../lib/deos_core/src/deos_dispatch.c
    ../../lib/deos_core/src/deos_codec.c
    ../../lib/deos_core/src/deos_network.c
    ../../lib/deos_core/src/deos_router.c
    ../../lib/deos_core/src/deos_fault.c
)

zephyr_include_directories(../../lib/deos_core/include)
```

## prj.conf
```kconfig
CONFIG_PRINTK=y
CONFIG_ASSERT=y
CONFIG_LOG=y
CONFIG_LOG_DEFAULT_LEVEL=3
CONFIG_MAIN_STACK_SIZE=2048
CONFIG_CAN=y
```

## src/main.c
```c
#include <zephyr/kernel.h>
#include <zephyr/logging/log.h>
#include <deos/deos.h>

#include "traction_app.h"
#include "traction_config.h"
#include "traction_hw.h"
#include "traction_control.h"

LOG_MODULE_REGISTER(traction_main, LOG_LEVEL_INF);

extern void traction_handlers_init(void);

int main(void)
{
    LOG_INF("Starting Traction Node Initialization...");
    
    // 1. App layer init
    traction_app_init();
    traction_config_init();
    traction_hw_init();
    
    // 2. DEOS core config and init
    struct deos_config d_cfg = {
        .node_id = DEOS_NODE_TRACTION,
        .can_dev = NULL, // Hardware binding could be added later
        .router_enabled = false,
        .hosted_nodes_enabled = false
    };
    
    if (deos_init(&d_cfg) < 0) {
        LOG_ERR("Failed to initialize DEOS core");
        return -1;
    }
    
    // 3. Register Application handlers
    traction_handlers_init();
    
    // 4. Start Control Loop
    traction_control_init();
    
    // 5. Start DEOS
    if (deos_start() < 0) {
        LOG_ERR("Failed to start DEOS core");
        return -1;
    }
    
    LOG_INF("Traction Node Running.");
    
    // System automatically handles heartbeat and background tasks
    while (1) {
        k_sleep(K_SECONDS(1));
    }
    
    return 0;
}
```

## include/traction_app.h
```c
#ifndef TRACTION_APP_H
#define TRACTION_APP_H

#include <stdint.h>
#include <stdbool.h>
#include <deos/deos_icd.h>

/* Application state structure */
struct traction_app_state {
    uint16_t target_speed_raw;
    int16_t target_accel_raw;

    uint8_t target_gear; // deos_traction_gear_t
    uint16_t torque_limit_raw;

    uint16_t current_speed_raw;
    int16_t current_accel_raw;

    bool brake_active;
    bool emergency_stop;

    uint16_t bms_soc_raw;
    uint16_t bms_max_discharge_current_raw;
    uint16_t bms_max_charge_current_raw;

    deos_state_t system_state;
    deos_mode_t  system_mode;

    int64_t last_control_command_ms;
};

/* TODO: This should eventually go to public ICD if standardized */
struct traction_status_response_payload {
    uint16_t current_speed;
    int16_t current_accel;
    uint8_t current_gear;
    uint16_t torque_limit;
    uint8_t state_flags;
} __attribute__((packed));

extern struct traction_app_state g_traction_state;

void traction_app_init(void);
struct traction_app_state* traction_get_state(void);

#endif /* TRACTION_APP_H */
```

## include/traction_config.h
```c
#ifndef TRACTION_CONFIG_H
#define TRACTION_CONFIG_H

#include <stdint.h>
#include <stddef.h>
#include <deos/deos_icd.h>

struct traction_config {
    uint16_t pid_kp;
    uint16_t pid_ki;
    uint16_t pid_kd;
    uint16_t max_current;
    uint16_t max_speed;
    uint16_t accel_limit;
    uint16_t cmd_timeout_ms;
    uint8_t pole_pairs;
    uint16_t gear_ratio;
    uint16_t wheel_circum_mm;
    uint16_t regen_cutoff_speed;
};

extern struct traction_config g_traction_config;

void traction_config_init(void);

/* Parameter handlers */
int traction_config_get_param(deos_traction_parameter_t param, void *out_val, size_t *out_len);
int traction_config_set_param(deos_traction_parameter_t param, const void *val, size_t len);

#endif /* TRACTION_CONFIG_H */
```

## include/traction_control.h
```c
#ifndef TRACTION_CONTROL_H
#define TRACTION_CONTROL_H

#include <stdbool.h>

void traction_control_init(void);

/* Safety Logic */
bool traction_is_command_timed_out(void);
bool traction_is_drive_allowed(void);
void traction_apply_safety_limits(void);

#endif /* TRACTION_CONTROL_H */
```

## include/traction_hw.h
```c
#ifndef TRACTION_HW_H
#define TRACTION_HW_H

#include <stdint.h>
#include <deos/deos_icd.h>

void traction_hw_init(void);

/* Stubs for actual motor controller hardware interaction */
void traction_hw_set_output(uint16_t speed, int16_t accel, uint16_t torque_limit);
void traction_hw_set_gear(deos_traction_gear_t gear);
void traction_hw_emergency_stop(void);

#endif /* TRACTION_HW_H */
```

## src/traction_app.c
```c
#include "traction_app.h"
#include <string.h>
#include <zephyr/kernel.h>

struct traction_app_state g_traction_state;

void traction_app_init(void)
{
    memset(&g_traction_state, 0, sizeof(g_traction_state));
    
    // Default safe state
    g_traction_state.target_gear = DEOS_GEAR_PARK;
    g_traction_state.emergency_stop = false;
    g_traction_state.brake_active = false;
    g_traction_state.system_state = DEOS_STATE_INIT;
    g_traction_state.system_mode = DEOS_MODE_NORMAL;
    g_traction_state.last_control_command_ms = k_uptime_get();
}

struct traction_app_state* traction_get_state(void)
{
    return &g_traction_state;
}
```

## src/traction_config.c
```c
#include "traction_config.h"
#include <string.h>

struct traction_config g_traction_config;

void traction_config_init(void)
{
    // Load defaults
    memset(&g_traction_config, 0, sizeof(g_traction_config));
    
    g_traction_config.pid_kp = 100;
    g_traction_config.pid_ki = 10;
    g_traction_config.pid_kd = 5;
    g_traction_config.max_current = 2000;  // 200.0 A (scale: 0.1A)
    g_traction_config.max_speed = 3000;    // 30 m/s
    g_traction_config.accel_limit = 500;   // 5 m/s^2
    g_traction_config.cmd_timeout_ms = 200;
    g_traction_config.pole_pairs = 4;
    g_traction_config.gear_ratio = 1000;   // 10.00
    g_traction_config.wheel_circum_mm = 2000;
    g_traction_config.regen_cutoff_speed = 200; // 2 m/s
}

int traction_config_get_param(deos_traction_parameter_t param, void *out_val, size_t *out_len)
{
    if (!out_val || !out_len) return -1;
    
    switch (param) {
        case DEOS_PARAM_TRACTION_PID_KP:
            memcpy(out_val, &g_traction_config.pid_kp, sizeof(uint16_t));
            *out_len = sizeof(uint16_t);
            return 0;
        case DEOS_PARAM_TRACTION_PID_KI:
            memcpy(out_val, &g_traction_config.pid_ki, sizeof(uint16_t));
            *out_len = sizeof(uint16_t);
            return 0;
        case DEOS_PARAM_TRACTION_PID_KD:
            memcpy(out_val, &g_traction_config.pid_kd, sizeof(uint16_t));
            *out_len = sizeof(uint16_t);
            return 0;
        case DEOS_PARAM_TRACTION_MAX_CURRENT:
            memcpy(out_val, &g_traction_config.max_current, sizeof(uint16_t));
            *out_len = sizeof(uint16_t);
            return 0;
        case DEOS_PARAM_TRACTION_MAX_SPEED:
            memcpy(out_val, &g_traction_config.max_speed, sizeof(uint16_t));
            *out_len = sizeof(uint16_t);
            return 0;
        case DEOS_PARAM_TRACTION_ACCEL_LIMIT:
            memcpy(out_val, &g_traction_config.accel_limit, sizeof(uint16_t));
            *out_len = sizeof(uint16_t);
            return 0;
        case DEOS_PARAM_TRACTION_CMD_TIMEOUT_MS:
            memcpy(out_val, &g_traction_config.cmd_timeout_ms, sizeof(uint16_t));
            *out_len = sizeof(uint16_t);
            return 0;
        case DEOS_PARAM_TRACTION_POLE_PAIRS:
            memcpy(out_val, &g_traction_config.pole_pairs, sizeof(uint8_t));
            *out_len = sizeof(uint8_t);
            return 0;
        case DEOS_PARAM_TRACTION_GEAR_RATIO:
            memcpy(out_val, &g_traction_config.gear_ratio, sizeof(uint16_t));
            *out_len = sizeof(uint16_t);
            return 0;
        case DEOS_PARAM_TRACTION_WHEEL_CIRCUM_MM:
            memcpy(out_val, &g_traction_config.wheel_circum_mm, sizeof(uint16_t));
            *out_len = sizeof(uint16_t);
            return 0;
        case DEOS_PARAM_TRACTION_REGEN_CUTOFF_SPD:
            memcpy(out_val, &g_traction_config.regen_cutoff_speed, sizeof(uint16_t));
            *out_len = sizeof(uint16_t);
            return 0;
        default:
            return -1;
    }
}

int traction_config_set_param(deos_traction_parameter_t param, const void *val, size_t len)
{
    if (!val) return -1;
    
    switch (param) {
        case DEOS_PARAM_TRACTION_PID_KP:
            if (len != sizeof(uint16_t)) return -1;
            memcpy(&g_traction_config.pid_kp, val, len);
            return 0;
        case DEOS_PARAM_TRACTION_PID_KI:
            if (len != sizeof(uint16_t)) return -1;
            memcpy(&g_traction_config.pid_ki, val, len);
            return 0;
        case DEOS_PARAM_TRACTION_PID_KD:
            if (len != sizeof(uint16_t)) return -1;
            memcpy(&g_traction_config.pid_kd, val, len);
            return 0;
        case DEOS_PARAM_TRACTION_MAX_CURRENT:
            if (len != sizeof(uint16_t)) return -1;
            memcpy(&g_traction_config.max_current, val, len);
            return 0;
        case DEOS_PARAM_TRACTION_MAX_SPEED:
            if (len != sizeof(uint16_t)) return -1;
            memcpy(&g_traction_config.max_speed, val, len);
            return 0;
        case DEOS_PARAM_TRACTION_ACCEL_LIMIT:
            if (len != sizeof(uint16_t)) return -1;
            memcpy(&g_traction_config.accel_limit, val, len);
            return 0;
        case DEOS_PARAM_TRACTION_CMD_TIMEOUT_MS:
            if (len != sizeof(uint16_t)) return -1;
            memcpy(&g_traction_config.cmd_timeout_ms, val, len);
            return 0;
        case DEOS_PARAM_TRACTION_POLE_PAIRS:
            if (len != sizeof(uint8_t)) return -1;
            memcpy(&g_traction_config.pole_pairs, val, len);
            return 0;
        case DEOS_PARAM_TRACTION_GEAR_RATIO:
            if (len != sizeof(uint16_t)) return -1;
            memcpy(&g_traction_config.gear_ratio, val, len);
            return 0;
        case DEOS_PARAM_TRACTION_WHEEL_CIRCUM_MM:
            if (len != sizeof(uint16_t)) return -1;
            memcpy(&g_traction_config.wheel_circum_mm, val, len);
            return 0;
        case DEOS_PARAM_TRACTION_REGEN_CUTOFF_SPD:
            if (len != sizeof(uint16_t)) return -1;
            memcpy(&g_traction_config.regen_cutoff_speed, val, len);
            return 0;
        default:
            return -1; // Unsupported
    }
}
```

## src/traction_control.c
```c
#include "traction_control.h"
#include "traction_app.h"
#include "traction_hw.h"
#include "traction_config.h"
#include <zephyr/kernel.h>
#include <zephyr/logging/log.h>

LOG_MODULE_REGISTER(traction_ctrl, LOG_LEVEL_INF);

#define TRACTION_CONTROL_THREAD_STACK_SIZE 1024
#define TRACTION_CONTROL_THREAD_PRIORITY 5

K_THREAD_STACK_DEFINE(traction_ctrl_stack, TRACTION_CONTROL_THREAD_STACK_SIZE);
static struct k_thread traction_ctrl_thread_data;

bool traction_is_command_timed_out(void)
{
    int64_t now = k_uptime_get();
    if ((now - g_traction_state.last_control_command_ms) > g_traction_config.cmd_timeout_ms) {
        return true;
    }
    return false;
}

bool traction_is_drive_allowed(void)
{
    if (g_traction_state.emergency_stop) {
        return false;
    }
    
    if (g_traction_state.brake_active) {
        return false;
    }
    
    if (traction_is_command_timed_out()) {
        return false;
    }
    
    if (g_traction_state.target_gear == DEOS_GEAR_PARK || 
        g_traction_state.target_gear == DEOS_GEAR_NEUTRAL) {
        return false;
    }

    return true;
}

void traction_apply_safety_limits(void)
{
    // For example, if SOC > 95%, limit regen
    if (g_traction_state.bms_soc_raw > 9500) { // 95.00%
        // Disable or reduce regen torque limit
    }
    
    // TODO: Need proper torque-to-current mapping model before clamping torque limit with max_current.
    // torque_limit_raw is 0.01 % and max_current is 0.1 A, so direct comparison is invalid.
}

static void traction_control_loop(void *arg1, void *arg2, void *arg3)
{
    LOG_INF("Traction control loop started");
    
    while (1) {
        // 1. Safety Checks
        bool drive_allowed = traction_is_drive_allowed();
        
        // 2. Apply Limits
        traction_apply_safety_limits();
        
        // 3. Hardware Output Placeholder
        if (drive_allowed) {
            traction_hw_set_output(
                g_traction_state.target_speed_raw,
                g_traction_state.target_accel_raw,
                g_traction_state.torque_limit_raw
            );
        } else {
            // Send 0 output or neutral command to HW
            traction_hw_set_output(0, 0, 0);
        }
        
        k_sleep(K_MSEC(20)); // 50 Hz control loop
    }
}

void traction_control_init(void)
{
    k_thread_create(&traction_ctrl_thread_data, traction_ctrl_stack,
                    K_THREAD_STACK_SIZEOF(traction_ctrl_stack),
                    traction_control_loop,
                    NULL, NULL, NULL,
                    TRACTION_CONTROL_THREAD_PRIORITY, 0, K_NO_WAIT);
}
```

## src/traction_handlers.c
```c
#include "traction_app.h"
#include "traction_config.h"
#include "traction_hw.h"
#include <deos/deos.h>
#include <zephyr/logging/log.h>
#include <zephyr/kernel.h>
#include <string.h>

LOG_MODULE_REGISTER(traction_handlers, LOG_LEVEL_INF);

static int handle_set_target_speed(const deos_message_t *msg, void *user_data)
{
    if (msg->payload_len != sizeof(struct deos_traction_target_payload)) {
        return DEOS_RESULT_INVALID_PARAMETER;
    }
    
    const struct deos_traction_target_payload *payload = 
        (const struct deos_traction_target_payload *)msg->payload;
        
    if (payload->target_speed > g_traction_config.max_speed) {
        return DEOS_RESULT_OUT_OF_RANGE;
    }
    
    int16_t accel_limit = (int16_t)g_traction_config.accel_limit;
    if (payload->target_accel > accel_limit || payload->target_accel < -accel_limit) {
        return DEOS_RESULT_OUT_OF_RANGE;
    }
        
    g_traction_state.target_speed_raw = payload->target_speed;
    g_traction_state.target_accel_raw = payload->target_accel;
    g_traction_state.last_control_command_ms = k_uptime_get();
    
    return DEOS_RESULT_SUCCESS;
}

static int handle_set_gear(const deos_message_t *msg, void *user_data)
{
    if (msg->payload_len != sizeof(struct deos_traction_gear_payload)) {
        deos_send_response(msg, DEOS_RESULT_INVALID_PARAMETER, NULL, 0);
        return DEOS_RESULT_INVALID_PARAMETER;
    }
    
    const struct deos_traction_gear_payload *payload = 
        (const struct deos_traction_gear_payload *)msg->payload;
        
    if (payload->gear > DEOS_GEAR_PARK) {
        deos_send_response(msg, DEOS_RESULT_OUT_OF_RANGE, NULL, 0);
        return DEOS_RESULT_OUT_OF_RANGE;
    }
        
    // Validate gear change
    bool is_d_to_r = (g_traction_state.target_gear == DEOS_GEAR_DRIVE && payload->gear == DEOS_GEAR_REVERSE);
    bool is_r_to_d = (g_traction_state.target_gear == DEOS_GEAR_REVERSE && payload->gear == DEOS_GEAR_DRIVE);
    
    if ((is_d_to_r || is_r_to_d) && g_traction_state.current_speed_raw > 10) {
        deos_send_response(msg, DEOS_RESULT_NOT_ALLOWED, NULL, 0);
        return DEOS_RESULT_NOT_ALLOWED;
    }
    
    g_traction_state.target_gear = payload->gear;
    traction_hw_set_gear(payload->gear);
    
    deos_send_response(msg, DEOS_RESULT_SUCCESS, NULL, 0);
    return DEOS_RESULT_SUCCESS;
}

static int handle_set_torque_limit(const deos_message_t *msg, void *user_data)
{
    if (msg->payload_len != sizeof(struct deos_traction_torque_limit_payload)) {
        return DEOS_RESULT_INVALID_PARAMETER;
    }
    
    const struct deos_traction_torque_limit_payload *payload = 
        (const struct deos_traction_torque_limit_payload *)msg->payload;
        
    if (payload->torque_limit > 10000) {
        return DEOS_RESULT_OUT_OF_RANGE;
    }
        
    g_traction_state.torque_limit_raw = payload->torque_limit;
    
    return DEOS_RESULT_SUCCESS;
}

static int handle_get_status(const deos_message_t *msg, void *user_data)
{
    struct traction_status_response_payload resp;
    resp.current_speed = g_traction_state.current_speed_raw;
    resp.current_accel = g_traction_state.current_accel_raw;
    resp.current_gear = g_traction_state.target_gear;
    resp.torque_limit = g_traction_state.torque_limit_raw;
    resp.state_flags = 0;
    
    if (g_traction_state.emergency_stop) resp.state_flags |= 0x01;
    if (g_traction_state.brake_active) resp.state_flags |= 0x02;
    
    deos_send_response(msg, DEOS_RESULT_SUCCESS, &resp, sizeof(resp));
    
    return DEOS_RESULT_SUCCESS;
}

// Handler for listening to Brake status
static int handle_brake_status(const deos_message_t *msg, void *user_data)
{
    // Assuming byte 0 of Brake status is active flag (dummy logic for cross-node input)
    if (msg->payload_len > 0) {
        g_traction_state.brake_active = (msg->payload[0] != 0);
    }
    return DEOS_RESULT_SUCCESS;
}

// Handler for listening to BMS status
static int handle_bms_status(const deos_message_t *msg, void *user_data)
{
    // Dummy parsing for BMS SOC etc based on some generic payload assumption
    // In real system, this should use deos_bms_status_payload from deos_types.h
    return DEOS_RESULT_SUCCESS;
}

static int handle_get_parameter(const deos_message_t *msg, void *user_data)
{
    if (msg->payload_len < 2) {
        deos_send_response(msg, DEOS_RESULT_INVALID_PARAMETER, NULL, 0);
        return DEOS_RESULT_INVALID_PARAMETER;
    }
    
    uint16_t param_id;
    memcpy(&param_id, msg->payload, sizeof(uint16_t));
    
    uint8_t resp_buf[64];
    memcpy(resp_buf, &param_id, sizeof(uint16_t));
    
    size_t out_len = 0;
    int ret = traction_config_get_param((deos_traction_parameter_t)param_id, resp_buf + 2, &out_len);
    
    if (ret == 0) {
        deos_send_response(msg, DEOS_RESULT_SUCCESS, resp_buf, out_len + 2);
        return DEOS_RESULT_SUCCESS;
    }
    
    deos_send_response(msg, DEOS_RESULT_INVALID_PARAMETER, NULL, 0);
    return DEOS_RESULT_INVALID_PARAMETER;
}

static int handle_set_parameter(const deos_message_t *msg, void *user_data)
{
    if (msg->payload_len < 2) {
        deos_send_response(msg, DEOS_RESULT_INVALID_PARAMETER, NULL, 0);
        return DEOS_RESULT_INVALID_PARAMETER;
    }
    
    uint16_t param_id;
    memcpy(&param_id, msg->payload, sizeof(uint16_t));
    
    int ret = traction_config_set_param(
        (deos_traction_parameter_t)param_id, 
        msg->payload + 2, 
        msg->payload_len - 2
    );
    
    deos_result_t res = (ret == 0) ? DEOS_RESULT_SUCCESS : DEOS_RESULT_INVALID_PARAMETER;
    deos_send_response(msg, res, NULL, 0);
    
    return (ret == 0) ? DEOS_RESULT_SUCCESS : DEOS_RESULT_INVALID_PARAMETER;
}

static int handle_set_state(const deos_message_t *msg, void *user_data)
{
    if (msg->payload_len != 1) {
        deos_send_response(msg, DEOS_RESULT_INVALID_PARAMETER, NULL, 0);
        return DEOS_RESULT_INVALID_PARAMETER;
    }
    deos_state_t new_state = (deos_state_t)msg->payload[0];
    
    // Example state transition validation
    if (new_state == DEOS_STATE_UNKNOWN) {
        deos_send_response(msg, DEOS_RESULT_INVALID_PARAMETER, NULL, 0);
        return DEOS_RESULT_INVALID_PARAMETER;
    }
    
    // Accept transition
    g_traction_state.system_state = new_state;
    deos_send_response(msg, DEOS_RESULT_SUCCESS, NULL, 0);
    return DEOS_RESULT_SUCCESS;
}

static int handle_set_mode(const deos_message_t *msg, void *user_data)
{
    if (msg->payload_len != 1) {
        deos_send_response(msg, DEOS_RESULT_INVALID_PARAMETER, NULL, 0);
        return DEOS_RESULT_INVALID_PARAMETER;
    }
    deos_mode_t new_mode = (deos_mode_t)msg->payload[0];
    
    if (new_mode == DEOS_MODE_UNKNOWN) {
        deos_send_response(msg, DEOS_RESULT_INVALID_PARAMETER, NULL, 0);
        return DEOS_RESULT_INVALID_PARAMETER;
    }
    
    g_traction_state.system_mode = new_mode;
    deos_send_response(msg, DEOS_RESULT_SUCCESS, NULL, 0);
    return DEOS_RESULT_SUCCESS;
}

void traction_handlers_init(void)
{
    // Command Handlers (TRACTION)
    deos_register_handler(DEOS_CLASS_COMMAND, DEOS_SERVICE_TRACTION, DEOS_CMD_TRACTION_SET_TARGET_SPEED, handle_set_target_speed, NULL);
    deos_register_handler(DEOS_CLASS_COMMAND, DEOS_SERVICE_TRACTION, DEOS_CMD_TRACTION_SET_GEAR, handle_set_gear, NULL);
    deos_register_handler(DEOS_CLASS_COMMAND, DEOS_SERVICE_TRACTION, DEOS_CMD_TRACTION_SET_TORQUE_LIMIT, handle_set_torque_limit, NULL);
    
    // Request Handlers (TRACTION)
    deos_register_handler(DEOS_CLASS_REQUEST, DEOS_SERVICE_TRACTION, DEOS_CMD_TRACTION_GET_STATUS, handle_get_status, NULL);
    
    // Config Handlers (TRACTION)
    deos_register_handler(DEOS_CLASS_CONFIG, DEOS_SERVICE_TRACTION, DEOS_CMD_GET_PARAMETER, handle_get_parameter, NULL);
    deos_register_handler(DEOS_CLASS_CONFIG, DEOS_SERVICE_TRACTION, DEOS_CMD_SET_PARAMETER, handle_set_parameter, NULL);
    
    // Cross-node Status Listeners
    // For brake, we can listen to response/status class, brake service, get_status command
    deos_register_handler(DEOS_CLASS_RESPONSE, DEOS_SERVICE_BRAKE, DEOS_CMD_BRAKE_GET_STATUS, handle_brake_status, NULL);
    deos_register_handler(DEOS_CLASS_RESPONSE, DEOS_SERVICE_BMS, DEOS_CMD_BMS_GET_STATUS, handle_bms_status, NULL);
    
    // System Handlers
    deos_register_handler(DEOS_CLASS_COMMAND, DEOS_SERVICE_SYSTEM, DEOS_CMD_SYSTEM_SET_STATE, handle_set_state, NULL);
    deos_register_handler(DEOS_CLASS_COMMAND, DEOS_SERVICE_SYSTEM, DEOS_CMD_SYSTEM_SET_MODE, handle_set_mode, NULL);
    
    LOG_INF("Traction handlers registered");
}
```

## src/traction_hw.c
```c
#include "traction_hw.h"
#include <zephyr/kernel.h>
#include <zephyr/logging/log.h>

LOG_MODULE_REGISTER(traction_hw, LOG_LEVEL_INF);

void traction_hw_init(void)
{
    LOG_INF("Traction hardware initialized (stub)");
}

void traction_hw_set_output(uint16_t speed, int16_t accel, uint16_t torque_limit)
{
    // Stub: send command to actual motor controller (e.g. Kelly KEB)
    // LOG_DBG("HW SET: speed=%u, accel=%d, torque=%u", speed, accel, torque_limit);
}

void traction_hw_set_gear(deos_traction_gear_t gear)
{
    LOG_INF("HW GEAR SET: %d", gear);
}

void traction_hw_emergency_stop(void)
{
    LOG_ERR("HW EMERGENCY STOP");
    // Hard stop output
}
```
